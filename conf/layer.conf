## conf/layer.conf
```bitbake
# We have a conf and classes directory, append to BBPATH
BBPATH .= ":${LAYERDIR}"

# We have a recipes directory, add to BBFILES
BBFILES += "${LAYERDIR}/recipes*/*/*.bb ${LAYERDIR}/recipes*/*/*.bbappend"
BBFILE_COLLECTIONS += "meta-lv2"
BBFILE_PATTERN_meta-lv2 := "^${LAYERDIR}/"
BBFILE_PRIORITY_meta-lv2 = "8"
LAYERSERIES_COMPAT_meta-lv2 = "warrior zeus"
```
